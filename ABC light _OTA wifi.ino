#include <WiFi.h>
#include <HTTPClient.h>
#include <HTTPUpdate.h>
//#include <ESP32httpUpdate.h>
#include <FastLED.h>
#include <WiFiClientSecure.h>
#include "cert.h"
#define NUM_LEDS 3000
#define DATA_PIN 18
CRGB leds[NUM_LEDS];
static int state = 0;
bool set_old = 0;
bool set = 0;
static int state_base = 0;

const char * ssid = "Control1";
const char * password = "12345678";


String FirmwareVer = {
  "0.1"
}; // current firmware version.

#define URL_fw_Version "https://raw.githubusercontent.com/programmer131/ESP8266_ESP32_SelfUpdate/master/esp32_ota/bin_version.txt"
#define URL_fw_Bin "https://raw.githubusercontent.com/programmer131/ESP8266_ESP32_SelfUpdate/master/esp32_ota/fw.bin"

//#define URL_fw_Version "http://cade-make.000webhostapp.com/version.txt"
//#define URL_fw_Bin "http://cade-make.000webhostapp.com/firmware.bin"

void connect_wifi();
void firmwareUpdate();
int FirmwareVersionCheck();

unsigned long previousMillis = 0; // will store last time LED was updated
unsigned long previousMillis_2 = 0;
const long interval = 30000;
const long mini_interval = 1000;
void repeatedCall() {
  static int num=0;
  unsigned long currentMillis = millis();
  if ((currentMillis - previousMillis) >= interval) {
    // save the last time you blinked the LED
    previousMillis = currentMillis;
    if (FirmwareVersionCheck()) {
      firmwareUpdate();
    }
  }
  if ((currentMillis - previousMillis_2) >= mini_interval) {
    previousMillis_2 = currentMillis;
    Serial.print("idle loop...");
    Serial.print(num++);
    Serial.print(" Active fw version:");
    Serial.println(FirmwareVer);
   if(WiFi.status() == WL_CONNECTED) 
   {
       Serial.println("wifi connected");
   }
   else
   {
    connect_wifi();
   }
  }
}

bool prominance [60][50]={
             
             {0, 0, 0, 0, 0, 0, 0, 0, 0, 0, 0, 0, 0,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 0, 0},
             {0, 0, 0, 0, 0, 0, 0, 0, 0, 0, 0, 0, 0,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 0, 0},
             {0, 0, 0, 0, 0, 0, 0, 0, 0, 0, 0, 0, 0,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 0, 0},
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             {0, 0, 0, 0, 0, 0, 0, 0, 0, 0, 0, 0, 0,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 0, 0},           


             
             };       


bool Clear [60][50]={
             { 0, 0, 0, 0, 0, 0, 0, 0, 0, 0, 0, 0, 0,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 0, 0},
             { 0, 0, 0, 0, 0, 0, 0, 0, 0, 0, 0, 0, 0,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 0, 0},
             { 0, 0, 0, 0, 0, 0, 0, 0, 0, 0, 0, 0, 0,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 0, 0},
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             { 0, 0, 0, 0, 0, 0, 0, 0, 0, 0, 0, 0, 0,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 0, 0},           


};






bool ABC [60][50]={
             { 0, 0, 0, 0, 0, 0, 0, 0, 0, 0, 0, 0, 0,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 0, 0},
             { 0, 0, 0, 0, 0, 0, 0, 0, 0, 0, 0, 0, 1,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 0, 0},
             { 0, 0, 0, 0, 0, 0, 0, 0, 0, 0, 0, 0, 1,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 0, 0},
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             { 0, 0, 0, 0, 0, 0, 0, 0, 0, 0, 0, 0, 0,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 0, 0},           


            };   


void cycle()
{
  static uint8_t hue = 0;
  Serial.print("x");
  // First slide the led in one direction
  for(int i = 0; i < NUM_LEDS; i++) {
    // Set the i'th led to red 
    leds[i] = CHSV(hue++, 255, 255);
    // Show the leds
    FastLED.show(); 
    // now that we've shown the leds, reset the i'th led to black
    // leds[i] = CRGB::Black;
    fadeall();
    // Wait a little bit before we loop around and do it again
    delay(3);
}
  Serial.print("x");

  // Now go in the other direction.  
  for(int i = (NUM_LEDS)-1; i >= 0; i--) {
    // Set the i'th led to red 
    leds[i] = CHSV(hue++, 255, 255);
    // Show the leds
    FastLED.show();
    // now that we've shown the leds, reset the i'th led to black
    // leds[i] = CRGB::Black;
    fadeall();
    // Wait a little bit before we loop around and do it again
    delay(3);
  }

}



void fadeall() {
  for (int i = 0; i < NUM_LEDS; i++) { leds[i].nscale8(250); }
}
void setup()
{
  Serial.begin(115200);
  Serial.println("");
  Serial.println("Start");
  WiFi.mode(WIFI_STA);
  WiFi.begin(ssid, password);

  //FastLED.addLeds<WS2812, DATA_PIN, RGB>(leds, NUM_LEDS);
  FastLED.addLeds<NEOPIXEL, DATA_PIN>(leds, NUM_LEDS);
  FastLED.setBrightness(230);
  // pinMode(IN_PIN, INPUT_PULLUP);
  // attachInterrupt(IN_PIN, toggleLED, FALLING);
  //cycle();
 
  delay(1000);
   FastLED.clear();
  for(int i=0; i<=NUM_LEDS;i++)
  {
    leds[i] = CRGB(255, 0, 255);
    delay(1);
    //FastLED.show();
  }
  FastLED.show();
  delay(3000);
connect_wifi();
}

void connect_wifi() {
  Serial.println("Waiting for WiFi");
  WiFi.begin(ssid, password);
  while (WiFi.status() != WL_CONNECTED) {
    delay(500);
    Serial.print(".");
  }

  Serial.println("");
  Serial.println("WiFi connected");
  Serial.println("IP address: ");
  Serial.println(WiFi.localIP());
}


void firmwareUpdate(void) {
  WiFiClientSecure client;
  client.setCACert(rootCACertificate);
  httpUpdate.setLedPin(LED_BUILTIN, LOW);
  t_httpUpdate_return ret = httpUpdate.update(client, URL_fw_Bin);

  switch (ret) {
  case HTTP_UPDATE_FAILED:
    Serial.printf("HTTP_UPDATE_FAILD Error (%d): %s\n", httpUpdate.getLastError(), httpUpdate.getLastErrorString().c_str());
    break;

  case HTTP_UPDATE_NO_UPDATES:
    Serial.println("HTTP_UPDATE_NO_UPDATES");
    break;

  case HTTP_UPDATE_OK:
    Serial.println("HTTP_UPDATE_OK");
    break;
  }
}
int FirmwareVersionCheck(void) {
  String payload;
  int httpCode;
  String fwurl = "";
  fwurl += URL_fw_Version;
  fwurl += "?";
  fwurl += String(rand());
  Serial.println(fwurl);
  WiFiClientSecure * client = new WiFiClientSecure;

  if (client) 
  {
    client -> setCACert(rootCACertificate);

    // Add a scoping block for HTTPClient https to make sure it is destroyed before WiFiClientSecure *client is 
    HTTPClient https;

    if (https.begin( * client, fwurl)) 
    { // HTTPS      
      Serial.print("[HTTPS] GET...\n");
      // start connection and send HTTP header
      delay(100);
      httpCode = https.GET();
      delay(100);
      if (httpCode == HTTP_CODE_OK) // if version received
      {
        payload = https.getString(); // save received version
      } else {
        Serial.print("error in downloading version file:");
        Serial.println(httpCode);
      }
      https.end();
    }
    delete client;
  }
      
  if (httpCode == HTTP_CODE_OK) // if version received
  {
    payload.trim();
    if (payload.equals(FirmwareVer)) {
      Serial.printf("\nDevice already on latest firmware version:%s\n", FirmwareVer);
      return 0;
    } 
    else 
    {
      Serial.println(payload);
      Serial.println("New firmware detected");
      return 1;
    }
  } 
  return 0;  
}

void loop()
{ 
  repeatedCall();  
  FastLED.clear();


  Serial.println("ABC logo red");

for(int i=1; i<=50;i++)
{
  for(int j=1; j<=60;j++)
  {
 if((i%2)==0) leds[(i*60)-j] = CRGB((255*(ABC[j][i])), 0, 0);

  else leds[j+((i-1)*60)] = CRGB((255*(ABC[j][i])), 0, 0);

  }
  delay(5);
    FastLED.show();
}

delay(3000);
Serial.println("Clear ABC");
FastLED.clear();
for(int i=1; i<=NUM_LEDS;i++)
{
   leds[i] = CRGB(0, 0, 0);
  }
 
    FastLED.show();


delay(1000);

Serial.println("Prominance start");
for(int i=1; i<=50;i++)
{
  for(int j=1; j<=60;j++)
  {
 if((i%2)==0) leds[(i*60)-j] = CRGB(0,(255*(prominance[j][i])),0);

  else leds[j+((i-1)*60)] = CRGB(0,(255*(prominance [j][i])),0);

  }
  delay(5);
    FastLED.show();
}

delay(3000);
Serial.println("Clear Prominance");
FastLED.clear();

for(int i=1; i<=NUM_LEDS;i++)
{
   leds[i] = CRGB(0, 0, 0);
  }
 
    FastLED.show();


delay(1000);


  Serial.println("ABC logo Green");




for(int i=1; i<=50;i++)
{
  for(int j=1; j<=60;j++)
  {
 if((i%2)==0) leds[(i*60)-j] = CRGB(0,(255*(ABC[j][i])), 0);

  else leds[j+((i-1)*60)] = CRGB(0,(255*(ABC[j][i])), 0);

  }
  delay(5);
    FastLED.show();
}

delay(3000);
Serial.println("Clear ABC");
FastLED.clear();
for(int i=1; i<=NUM_LEDS;i++)
{
   leds[i] = CRGB(0, 0, 0);
  }
 
    FastLED.show();


delay(1000);

  Serial.println("ABC logo");
Serial.println("Prominance start");
for(int i=1; i<=50;i++)
{
  for(int j=1; j<=60;j++)
  {
 if((i%2)==0) leds[(i*60)-j] = CRGB((0,0,255*(prominance[j][i])));

  else leds[j+((i-1)*60)] = CRGB((0,0,255*(prominance [j][i])));

  }
  delay(5);
    FastLED.show();
}

delay(3000);
Serial.println("Clear Prominance");
FastLED.clear();

for(int i=1; i<=NUM_LEDS;i++)
{
   leds[i] = CRGB(0, 0, 0);
  }
 
    FastLED.show();


delay(1000);


for(int i=1; i<=50;i++)
{
  for(int j=1; j<=60;j++)
  {
 if((i%2)==0) leds[(i*60)-j] = CRGB((253*(ABC[j][i])), (218*(ABC[j][i])), (13*(ABC[j][i])));

  else leds[j+((i-1)*60)] = CRGB((253*(ABC[j][i])), (218*(ABC[j][i])), (13*(ABC[j][i])));

  }
  delay(5);
    FastLED.show();
}

delay(3000);
Serial.println("Clear ABC");
FastLED.clear();
for(int i=1; i<=NUM_LEDS;i++)
{
   leds[i] = CRGB(0, 0, 0);
  }
 
    FastLED.show();


delay(1000);



  Serial.println("ABC logo");

for(int i=1; i<=50;i++)
{
  for(int j=1; j<=60;j++)
  {
 if((i%2)==0) leds[(i*60)-j] = CRGB((255*(ABC[j][i])), (218*(ABC[j][i])), (255*(ABC[j][i])));

  else leds[j+((i-1)*60)] = CRGB((255*(ABC[j][i])), (218*(ABC[j][i])), (255*(ABC[j][i])));

  }
  delay(5);
    FastLED.show();
}

delay(3000);
Serial.println("Clear ABC");
FastLED.clear();
for(int i=1; i<=NUM_LEDS;i++)
{
   leds[i] = CRGB(0, 0, 0);
  }
 
    FastLED.show();


delay(1000);


Serial.println("Prominance start");
for(int i=1; i<=50;i++)
{
  for(int j=1; j<=60;j++)
  {
 if((i%2)==0) leds[(i*60)-j] = CRGB((0,0,255*(prominance[j][i])));

  else leds[j+((i-1)*60)] = CRGB((0,0,255*(prominance [j][i])));

  }
  delay(5);
    FastLED.show();
}

delay(3000);
Serial.println("Clear Prominance");
FastLED.clear();

for(int i=1; i<=NUM_LEDS;i++)
{
   leds[i] = CRGB(0, 0, 0);
  }
 
    FastLED.show();


delay(1000);
  repeatedCall();
}